## components/cloud_upload/Kconfig
```kconfig
menu "Supabase upload"

config XIAO_SUPABASE_URL
    string "Supabase project URL"
    default ""
    help
        https://<ref>.supabase.co - set in sdkconfig.defaults.local (gitignored).

config XIAO_SUPABASE_KEY
    string "Supabase publishable key"
    default ""
    help
        sb_publishable_... - INSERT-only by RLS, and recoverable from flash, so it
        must never be the secret key. Set in sdkconfig.defaults.local (gitignored).

config XIAO_SNTP_SERVER
    string "SNTP server"
    default "pool.ntp.org"

endmenu
```

## components/philips_air/Kconfig
```kconfig
menu "Philips air purifier client"

config PURIFIER_TIMEOUT_MS
    int "Sync reply timeout (ms)"
    default 12000
    help
        Measured 2026-09-27 on an AC2220: sync replies take 60-300 ms; 12 s is
        headroom for a busy network. Status is not affected: it arrives by Observe
        notification whenever the purifier pushes.

endmenu
```

## components/wifi_sta/Kconfig
```kconfig
menu "Wi-Fi station"

config XIAO_WIFI_SSID
    string "SSID"
    default ""
    help
        Set in sdkconfig.defaults.local (gitignored), never in sdkconfig.defaults.

config XIAO_WIFI_PASSWORD
    string "Password"
    default ""

endmenu
```

## components/xiao_board/Kconfig
```kconfig
menu "XIAO ESP32-C6 board"

config XIAO_ANTENNA_EXTERNAL
    bool "Use the u.FL external antenna"
    default n
    help
        Drives GPIO14 high to route the radio to the u.FL connector.
        Leave off for the on-board ceramic antenna.

endmenu
```

## projects/02_airpurifier_coap/main/Kconfig.projbuild
```kconfig
menu "Air purifier"

config PURIFIER_HOST
    string "Purifier IPv4 address"
    default ""
    help
        Set in sdkconfig.defaults.local (gitignored). Find it with a CoAP sync probe
        across the LAN: the purifier does not answer ping.

config PURIFIER_PORT
    int "CoAP port"
    default 5683

endmenu
```

## projects/03_csi_presence/main/Kconfig.projbuild
```kconfig
menu "03 CSI presence"

config CSI_PING_INTERVAL_MS
    int "Ping interval to the gateway (ms); each reply is one CSI frame"
    range 5 1000
    default 20

config CSI_DEFAULT_THRESHOLD
    int "Motion threshold before calibration (motion units, x1000 CV)"
    range 1 100000
    default 60

config CSI_HOLD_S
    int "Seconds below threshold before present clears"
    range 5 3600
    default 60

endmenu
```
